## CMakeLists.txt
```
#
# Copyright (c) 2021 Nordic Semiconductor ASA
#
# SPDX-License-Identifier: Apache-2.0
#

cmake_minimum_required(VERSION 3.20.0)

find_package(Zephyr REQUIRED HINTS $ENV{ZEPHYR_BASE})

# get_target_property(TFM_BINARY_DIR tfm TFM_BINARY_DIR)
# configure_file(
#   ${CMAKE_CURRENT_LIST_DIR}/pox/tfm_manifest_list.yaml.in
#   ${CMAKE_CURRENT_BINARY_DIR}/pox/tfm_manifest_list.yaml
# )

set_property(TARGET zephyr_property_target
  APPEND PROPERTY TFM_CMAKE_OPTIONS
  # -DTFM_EXTRA_MANIFEST_LIST_FILES=${CMAKE_CURRENT_BINARY_DIR}/pox/tfm_manifest_list.yaml
  # -DTFM_EXTRA_PARTITION_PATHS=${CMAKE_CURRENT_LIST_DIR}/pox
)

project(tfm_secure_partition)

target_sources(app PRIVATE
  src/main.c
  src/psa_attestation.c
  src/util_sformat.c
  src/util_app_cfg.c
  src/util_app_log.c
  src/shell.c
)

target_include_directories(app PRIVATE
  $<TARGET_PROPERTY:tfm,TFM_BINARY_DIR>/api_ns/interface/include
)

target_compile_definitions(app
    PRIVATE TFM_PARTITION_POX
)
```

## prj.conf
```kconfig
#
# Copyright (c) 2021 Nordic Semiconductor ASA
#
# SPDX-License-Identifier: Apache-2.0
#

#CONFIG_LOG=y
#CONFIG_LOG_RUNTIME_FILTERING=y
#CONFIG_LOG_BUFFER_SIZE=2048
#CONFIG_LOG_PROCESS_TRIGGER_THRESHOLD=0
#CONFIG_LOG_DEFAULT_LEVEL=3

CONFIG_BUILD_WITH_TFM=y
CONFIG_TFM_PROFILE_TYPE_NOT_SET=y
CONFIG_TFM_CONNECTION_BASED_SERVICE_API=y

CONFIG_TFM_IPC=y
CONFIG_TFM_ISOLATION_LEVEL=1

# The Zephyr CMSIS emulation assumes that ticks are ms, currently
CONFIG_SYS_CLOCK_TICKS_PER_SEC=1000

CONFIG_MAIN_STACK_SIZE=4096
CONFIG_HEAP_MEM_POOL_SIZE=4096
CONFIG_COMMON_LIBC_MALLOC_ARENA_SIZE=4096

# Enable the initial attestation
CONFIG_TFM_PARTITION_INITIAL_ATTESTATION=y
CONFIG_TFM_QCBOR_PATH="DOWNLOAD"
CONFIG_TFM_PARTITION_POX=y
```

## src/main.c
```c
/*
 * Copyright (c) 2019,2020 Linaro Limited
 *
 * SPDX-License-Identifier: Apache-2.0
 */

#include <zephyr/kernel.h>
#include <zephyr/logging/log_ctrl.h>
#include <zephyr/logging/log.h>

#include "tfm_ns_interface.h"
#include "psa_attestation.h"
#include "util_app_cfg.h"
#include "util_app_log.h"
#include "util_sformat.h"

/** Declare a reference to the application logging interface. */
LOG_MODULE_DECLARE(app, CONFIG_LOG_DEFAULT_LEVEL);

/* Create an instance of the system config struct for the application. */
static struct cfg_data cfg;

int main(void)
{
    pox_test();
    return 0;
}
```

## src/main-1.c
```c
#include <stdio.h>
#include <stdlib.h>
#include "psa/client.h"
#include "psa_manifest/sid.h"
#include "util_sformat.h"

#define POX_SERVICE_SID 0xFFFFF0E1
#define POX_SERVICE_VERSION 1
#define CHALLENGE_SIZE 32
#define REPORT_BUF_SIZE 1024

int sample_function(void)
{
    return 12345; // Example output
}

int main(void)
{
    psa_handle_t handle;
    uint8_t challenge[CHALLENGE_SIZE] = {0};       // Example challenge data
    uintptr_t faddr = (uintptr_t)&sample_function; // Function address

    psa_invec in_vec[2] = {
        {challenge, CHALLENGE_SIZE},
        {&faddr, sizeof(uintptr_t)}};

    uint8_t *report_buf = malloc(REPORT_BUF_SIZE);
    size_t report_len = REPORT_BUF_SIZE;

    psa_outvec out_vec[2] = {
        {0},
        {report_buf, report_len} // PoX Report
    };

    int result;
    out_vec[0].base = &result;
    out_vec[0].len = sizeof(int);

    printf("[NS] Requesting Proof of Execution...\n");
    printf("[NS] SID: %X\n",POX_SERVICE_SID);
    handle = psa_connect(POX_SERVICE_SID, POX_SERVICE_VERSION);
    if (handle <= 0)
    {
        printf("[NS] ERROR: psa_connect() failed with status: %d\n", handle);
        return -1;
    }

    printf("[NS] Sending Challenge Size: %d, Function Ptr Size: %d\n", CHALLENGE_SIZE, (int)sizeof(uintptr_t));
    psa_status_t status = psa_call(handle, PSA_IPC_CALL, in_vec, 2, out_vec, 2);

    struct sf_hex_tbl_fmt fmt = {
        .ascii = false,
        .addr_label = false,
        .addr = 0};

    if (status == PSA_SUCCESS)
    {
        printf("[NS] Received Output: %d\n", result);
        printf("[NS] Received PoX Report.\n");
        sf_hex_tabulate_16(&fmt, report_buf, (size_t)report_len);
    }
    else
    {
        printf("[NS] ERROR: Failed to retrieve PoX report.\n");
    }

    psa_close(handle);
    free(report_buf); // Free allocated buffer
    return 0;
}
```

## src/psa_attestation.c
```c
/*
 * Copyright (c) 2019,2020 Linaro Limited
 *
 * SPDX-License-Identifier: Apache-2.0
 */

#include <zephyr/kernel.h>
#include <stdio.h>
#include <zephyr/logging/log.h>

#include "psa/initial_attestation.h"
#include "psa_attestation.h"
#include "util_sformat.h"
#include "util_app_log.h"

LOG_MODULE_DECLARE(app, CONFIG_LOG_DEFAULT_LEVEL);


psa_status_t att_get_iat(uint8_t *ch_buffer, uint32_t ch_sz,
                         uint8_t *token_buffer, uint32_t *token_sz)
{
    psa_status_t err = PSA_SUCCESS;
    uint32_t sys_token_sz;
    size_t token_buf_size = ATT_MAX_TOKEN_SIZE;

    /* Call with bigger challenge object than allowed */

    /*
     * First determine how large the token is on this system.
     * We don't need to compare with the size of ATT_MAX_TOKEN_SIZE here
     * since a check will be made in 'psa_initial_attest_get_token' and the
     * error return code will indicate a mismatch.
     */
    switch (ch_sz)
    {
    case 32:
        err = psa_initial_attest_get_token(
            ch_buffer,
            PSA_INITIAL_ATTEST_CHALLENGE_SIZE_32,
            token_buffer,
            token_buf_size,
            &sys_token_sz);
        break;
    case 48:
        err = psa_initial_attest_get_token(
            ch_buffer,
            PSA_INITIAL_ATTEST_CHALLENGE_SIZE_48,
            token_buffer,
            token_buf_size,
            &sys_token_sz);
        break;
    case 64:
        err = psa_initial_attest_get_token(
            ch_buffer,
            PSA_INITIAL_ATTEST_CHALLENGE_SIZE_64,
            token_buffer,
            token_buf_size,
            &sys_token_sz);
        break;
    default:
        err = -EINVAL;
        break;
    }
    if (err)
    {
        goto err;
    }

    LOG_INF("att: System IAT size is: %u bytes.", sys_token_sz);

    /* Request the initial attestation token w/the challenge data. */
    LOG_INF("att: Requesting IAT with %u byte challenge.", ch_sz);
    err = psa_initial_attest_get_token(
        ch_buffer,    /* Challenge/nonce input buffer. */
        ch_sz,        /* Challenge size (32, 48 or 64). */
        token_buffer, /* Token output buffer. */
        token_buf_size,
        token_sz /* Post exec output token size. */
    );
    LOG_INF("att: IAT data received: %u bytes.", *token_sz);

err:
    /* Log any eventual errors via app_log */
    return err ? al_psa_status(err, __func__) : err;
}

psa_status_t att_get_pox(uintptr_t *faddr, uint8_t *ch_buffer, uint32_t ch_sz,
                         uint8_t *token_buffer, uint32_t *token_sz)
{
    psa_status_t err = PSA_SUCCESS;
    uint32_t sys_token_sz;
    size_t token_buf_size = ATT_MAX_TOKEN_SIZE;

    /* Call with bigger challenge object than allowed */

    /*
     * First determine how large the token is on this system.
     * We don't need to compare with the size of ATT_MAX_TOKEN_SIZE here
     * since a check will be made in 'psa_initial_attest_get_token' and the
     * error return code will indicate a mismatch.
     */
    switch (ch_sz)
    {
    case 32:
        err = psa_proof_of_execution_get_token(
            faddr,
            ch_buffer,
            PSA_INITIAL_ATTEST_CHALLENGE_SIZE_32,
            token_buffer,
            token_buf_size,
            &sys_token_sz);
        break;
    case 48:
        err = psa_proof_of_execution_get_token(
            faddr,
            ch_buffer,
            PSA_INITIAL_ATTEST_CHALLENGE_SIZE_48,
            token_buffer,
            token_buf_size,
            &sys_token_sz);
        break;
    case 64:
        err = psa_proof_of_execution_get_token(
            faddr,
            ch_buffer,
            PSA_INITIAL_ATTEST_CHALLENGE_SIZE_64,
            token_buffer,
            token_buf_size,
            &sys_token_sz);
        break;
    default:
        err = -EINVAL;
        break;
    }
    if (err)
    {
        goto err;
    }

    LOG_INF("att: System POX size is: %u bytes.", sys_token_sz);

    /* Request the initial attestation token w/the challenge data. */
    LOG_INF("att: Requesting POX with %u byte challenge.", ch_sz);
    err = psa_proof_of_execution_get_token(
        faddr,
        ch_buffer,    /* Challenge/nonce input buffer. */
        ch_sz,        /* Challenge size (32, 48 or 64). */
        token_buffer, /* Token output buffer. */
        token_buf_size,
        token_sz /* Post exec output token size. */
    );
    LOG_INF("att: POX data received: %u bytes.", *token_sz);

err:
    /* Log any eventual errors via app_log */
    return err ? al_psa_status(err, __func__) : err;
}

int sample_function2(void)
{
    return 12345; // Example output
}

psa_status_t pox_test(void)
{
    psa_status_t err = PSA_SUCCESS;

    /* 64-byte nonce/challenge, encrypted using the default public key;
     *
     * 00 11 22 33 44 55 66 77 88 99 AA BB CC DD EE FF
     * 00 11 22 33 44 55 66 77 88 99 AA BB CC DD EE FF
     * 00 11 22 33 44 55 66 77 88 99 AA BB CC DD EE FF
     * 00 11 22 33 44 55 66 77 88 99 AA BB CC DD EE FF
     */
    uint32_t nonce_sz = 32;
    // uint8_t nonce_buf[ATT_MAX_TOKEN_SIZE] = {
    //     0x00, 0x11, 0x22, 0x33, 0x44, 0x55, 0x66, 0x77,
    //     0x88, 0x99, 0xAA, 0xBB, 0xCC, 0xDD, 0xEE, 0xFF,
    //     0x00, 0x11, 0x22, 0x33, 0x44, 0x55, 0x66, 0x77,
    //     0x88, 0x99, 0xAA, 0xBB, 0xCC, 0xDD, 0xEE, 0xFF,
    //     0x00, 0x11, 0x22, 0x33, 0x44, 0x55, 0x66, 0x77,
    //     0x88, 0x99, 0xAA, 0xBB, 0xCC, 0xDD, 0xEE, 0xFF,
    //     0x00, 0x11, 0x22, 0x33, 0x44, 0x55, 0x66, 0x77,
    //     0x88, 0x99, 0xAA, 0xBB, 0xCC, 0xDD, 0xEE, 0xFF,
    //     0};
    uint8_t nonce_buf[ATT_MAX_TOKEN_SIZE] = {0};
    /* POX response buffer. */
    uint32_t pox_sz = ATT_MAX_TOKEN_SIZE;
    uint8_t pox_buf[1024] = {0};

    /* String format output config. */
    struct sf_hex_tbl_fmt fmt = {
        .ascii = false,
        .addr_label = false,
        .addr = 0};

    /* Request the POX from the initial attestation service. */
    uintptr_t func_addr = (uintptr_t) sample_function2;
    err = att_get_pox(func_addr, nonce_buf, nonce_sz, pox_buf, &pox_sz);
    if (err)
    {
        goto err;
    }

    /* Display queued log messages before dumping the IAT. */
    al_dump_log();

    /* Dump the IAT for debug purposes. */
    sf_hex_tabulate_16(&fmt, pox_buf, (size_t)pox_sz);

err:
    return err;
}


psa_status_t iat_test(void)
{
    psa_status_t err = PSA_SUCCESS;

    /* 64-byte nonce/challenge, encrypted using the default public key;
     *
     * 00 11 22 33 44 55 66 77 88 99 AA BB CC DD EE FF
     * 00 11 22 33 44 55 66 77 88 99 AA BB CC DD EE FF
     * 00 11 22 33 44 55 66 77 88 99 AA BB CC DD EE FF
     * 00 11 22 33 44 55 66 77 88 99 AA BB CC DD EE FF
     */
    uint32_t nonce_sz = 32;
    // uint8_t nonce_buf[ATT_MAX_TOKEN_SIZE] = {
    //     0x00, 0x11, 0x22, 0x33, 0x44, 0x55, 0x66, 0x77,
    //     0x88, 0x99, 0xAA, 0xBB, 0xCC, 0xDD, 0xEE, 0xFF,
    //     0x00, 0x11, 0x22, 0x33, 0x44, 0x55, 0x66, 0x77,
    //     0x88, 0x99, 0xAA, 0xBB, 0xCC, 0xDD, 0xEE, 0xFF,
    //     0x00, 0x11, 0x22, 0x33, 0x44, 0x55, 0x66, 0x77,
    //     0x88, 0x99, 0xAA, 0xBB, 0xCC, 0xDD, 0xEE, 0xFF,
    //     0x00, 0x11, 0x22, 0x33, 0x44, 0x55, 0x66, 0x77,
    //     0x88, 0x99, 0xAA, 0xBB, 0xCC, 0xDD, 0xEE, 0xFF,
    //     0};
    uint8_t nonce_buf[ATT_MAX_TOKEN_SIZE] = {0};
    /* POX response buffer. */
    uint32_t iat_sz = ATT_MAX_TOKEN_SIZE;
    uint8_t iat_buf[1024] = {0};

    /* String format output config. */
    struct sf_hex_tbl_fmt fmt = {
        .ascii = false,
        .addr_label = false,
        .addr = 0};

    err = att_get_iat(nonce_buf, nonce_sz, iat_buf, &iat_sz);
    if (err)
    {
        goto err;
    }

    /* Display queued log messages before dumping the IAT. */
    al_dump_log();

    /* Dump the IAT for debug purposes. */
    sf_hex_tabulate_16(&fmt, iat_buf, (size_t)iat_sz);

err:
    return err;
}
```

## src/psa_attestation.h
```c
/*
 * Copyright (c) 2019,2020 Linaro Limited
 *
 * SPDX-License-Identifier: Apache-2.0
 */

#include <stdarg.h>

#include "psa/error.h"

#ifdef __cplusplus
extern "C" {
#endif

/** Maximum buffer size for an initial attestation token instance. */
#define ATT_MAX_TOKEN_SIZE (0x240)

/**
 * @brief Gets the public key portion of the attestation service's securely
 *        stored key pair. This public key can be provided to external
 *        verification services for device verification purposes.
 *
 * @return Returns error code as specified in \ref psa_status_t
 */
psa_status_t att_get_pub_key(void);

/**
 * @brief Gets an initial attestation token (IAT) from the TF-M secure
 *        processing environment (SPE). This data will be provided in CBOR
 *        format and is encrypted using the private key held on the SPE.
 *
 * The initial attestation token (IAT) is composed of a series of 'claims' or
 * data points used to uniquely identify this device to an external
 * verification entity (the IAT consumer).
 *
 * The generated IAT should be cryptographically verifiable by the IAT consumer.
 *
 * For details on IAT see https://tools.ietf.org/html/draft-mandyam-eat-01
 *
 * @param ch_buffer     Pointer to the buffer containing the nonce or
 *                      challenge data to be validated with the private key.
 * @param ch_sz         The number of bytes in the challenge. 32, 48 or 64.
 * @param token_buffer  Pointer to the buffer where the IAT will be written.
 *                      Must be equal in size to the system IAT output, which
 *                      can be determined via a call to
 *                      'psa_initial_attest_get_token_size'.
 * @param token_sz      Pointer to the size of token_buffer, this value will be
 *                      updated in this function to contain the number of bytes
 *                      actually retrieved during the IAT request.
 *
 * @return Returns error code as specified in \ref psa_status_t
 */
psa_status_t att_get_iat(uint8_t *ch_buffer, uint32_t ch_sz,
			 uint8_t *token_buffer, uint32_t *token_sz);

psa_status_t att_get_pox(uintptr_t *faddr, uint8_t *ch_buffer, uint32_t ch_sz,
			 uint8_t *token_buffer, uint32_t *token_sz);
/**
 * @brief TODO!
 *
 * @return Returns error code as specified in \ref psa_status_t
 */
psa_status_t pox_test(void);

#ifdef __cplusplus
}
#endif
```

## src/util_app_log.c
```c
/*
 * Copyright (c) 2019,2020 Linaro Limited
 *
 * SPDX-License-Identifier: Apache-2.0
 */
#include <zephyr/kernel.h>
#include <zephyr/logging/log_ctrl.h>
#include <zephyr/logging/log.h>

#include "psa/crypto.h"
#include "util_app_log.h"

#ifdef CONFIG_LOG
LOG_MODULE_REGISTER(app, CONFIG_LOG_DEFAULT_LEVEL);
#endif

psa_status_t al_psa_status(psa_status_t status, const char *func_name)
{
#ifdef CONFIG_LOG
	switch (status) {
	case PSA_SUCCESS:
		break;

	/* Generic PSA errors (psa/error.h). */
	case PSA_ERROR_PROGRAMMER_ERROR:
		LOG_ERR("Programmer error");
		break;
	case PSA_ERROR_CONNECTION_REFUSED:
		LOG_ERR("Connection refused");
		break;
	case PSA_ERROR_CONNECTION_BUSY:
		LOG_ERR("Connection busy");
		break;
	case PSA_ERROR_GENERIC_ERROR:
		LOG_ERR("Generic error");
		break;
	case PSA_ERROR_NOT_PERMITTED:
		LOG_ERR("Not permitted");
		break;
	case PSA_ERROR_NOT_SUPPORTED:
		LOG_ERR("Unsupported operation");
		break;
	case PSA_ERROR_INVALID_ARGUMENT:
		LOG_ERR("Invalid argument");
		break;
	case PSA_ERROR_INVALID_HANDLE:
		LOG_ERR("Invalid handle");
		break;
	case PSA_ERROR_BAD_STATE:
		LOG_ERR("Bad state");
		break;
	case PSA_ERROR_BUFFER_TOO_SMALL:
		LOG_ERR("Buffer too small");
		break;
	case PSA_ERROR_ALREADY_EXISTS:
		LOG_ERR("Already exists");
		break;
	case PSA_ERROR_DOES_NOT_EXIST:
		LOG_ERR("Does not exist");
		break;
	case PSA_ERROR_INSUFFICIENT_MEMORY:
		LOG_ERR("Insufficient memory");
		break;
	case PSA_ERROR_INSUFFICIENT_STORAGE:
		LOG_ERR("Insufficient storage");
		break;
	case PSA_ERROR_INSUFFICIENT_DATA:
		LOG_ERR("Insufficient memory data");
		break;
	case PSA_ERROR_SERVICE_FAILURE:
		LOG_ERR("Service failure");
		break;
	case PSA_ERROR_COMMUNICATION_FAILURE:
		LOG_ERR("Communication failure");
		break;
	case PSA_ERROR_STORAGE_FAILURE:
		LOG_ERR("Storage failure");
		break;
	case PSA_ERROR_HARDWARE_FAILURE:
		LOG_ERR("Hardware failure");
		break;
	case PSA_ERROR_INVALID_SIGNATURE:
		LOG_ERR("Invalid signature");
		break;

	/* PSA crypto errors (psa/crypto_values.h). */
	case PSA_ERROR_INSUFFICIENT_ENTROPY:
		LOG_ERR("CRYPTO: Insufficient entropy");
		break;
	case PSA_ERROR_CORRUPTION_DETECTED:
		LOG_ERR("CRYPTO: Tampering detected");
		break;

	/* Catch-all error handler. */
	default:
		LOG_ERR("Unhandled status response: %d", status);
		break;
	}

	/* Display the calling function name for debug purposes. */
	if (status != PSA_SUCCESS) {
		LOG_ERR("Function: '%s'", func_name);
	}
#endif

	return status;
}

void al_dump_log(void)
{
#ifdef CONFIG_LOG
	while (log_process()) {

	}
#endif
}
```

## src/util_sformat.c
```c
/*
 * Copyright (c) 2019,2020 Linaro Limited
 *
 * SPDX-License-Identifier: Apache-2.0
 */

#include <ctype.h>
#include <stdio.h>
#include "util_sformat.h"

static void sf_hex_ascii(unsigned char *data, size_t len, unsigned char nonvis)
{
	uint32_t idx;

	/* Render printable characters. */
	idx = 0;
	while (len) {
		printf("%c", isprint(data[idx]) ? data[idx] : nonvis);
		idx++;
		len--;
	}
}

void sf_hex_tabulate_16(struct sf_hex_tbl_fmt *fmt, unsigned char *data,
			size_t len)
{
	uint32_t idx;
	uint32_t cpos;     /* Current position. */
	uint32_t ca;       /* Current address. */
	uint32_t ea;       /* End address. */

	if (!len) {
		return;
	}

	/* Set the end address (since we modify len in the write loop). */
	ea = fmt->addr + len;

	/* Check if we need to render the top address bar. */
	if (fmt->addr_label) {
		/* Render the top address bar. */
		printk("\n");
		printk("          ");
		printk("0  1  2  3  4  5  6  7  8  9  ");
		printk("A  B  C  D  E  F\n");
		printk("%08X ", fmt->addr - (fmt->addr % 16));
	}

	/* Insert offset padding for first row if necessary. */
	cpos = fmt->addr % 16;
	if (cpos != 0) {
		for (idx = 0; idx < cpos; idx++) {
			printk("   ");
		}
	}

	/* Print data row by row. */
	idx = 0;
	ca = fmt->addr;
	while (len) {
		/* Print the current value. */
		printk("%02X ", data[idx++]);
		cpos++;
		ca++;

		/* Wrap around to the next line if necessary. */
		if (cpos == 16 || ca == ea) {
			/* Render ASCII equiv at end of row if requested. */
			if (fmt->ascii) {
				if (ca == ea) {
					/* Handle last/single row. */
					if (ca % 16) {
						/* PARTIAL row (< 16 vals). */
						printk("%.*s",
						       (16 - ca % 16) * 3,
						       "                "
						       "                "
						       "                ");
						sf_hex_ascii(
							&data[idx - (ca % 16)],
							ca - fmt->addr < 16 ?
							idx % 16 : ca % 16,
							'.');
					} else {
						/* FULL row. */
						sf_hex_ascii(
							&data[idx - 16],
							16, '.');
					}
				} else if (ca < fmt->addr + 15) {
					/* Handle first row. */
					printk("%.*s", fmt->addr % 16,
					       "                ");
					sf_hex_ascii(data,
						     16 - fmt->addr % 16, '.');
				} else {
					/* Full row. */
					sf_hex_ascii(&data[idx - 16], 16, '.');
				}
			}

			/* Wrap around if this isn't the last row. */
			printk("\n");
			if (ca != ea) {
				/* Render the next base row addr. */
				if (fmt->addr_label) {
					printk("%08X ", ca);
				}
			}
			cpos = 0;
		}
		len--;
	}
	printk("\n");
}
```
